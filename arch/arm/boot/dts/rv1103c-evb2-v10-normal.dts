// SPDX-License-Identifier: (GPL-2.0+ OR MIT)
/*
 * Copyright (c) 2024 Rockchip Electronics Co., Ltd.
 */

/dts-v1/;

#include "rv1103c.dtsi"
#include "rv1103c-evb2-v10.dtsi"
#include "rv1103c-evb2-cam.dtsi"

/ {
	model = "Rockchip RV1103C EVB2 V10 Board";
	compatible = "rockchip,rv1103c-evb2-v10-normal", "rockchip,rv1103c";
};

&fspi0 {
	status = "okay";

	flash@0 {
		compatible = "spi-nand";
		reg = <0>;
		spi-max-frequency = <75000000>;
		spi-rx-bus-width = <4>;
		spi-tx-bus-width = <1>;
	};
};
