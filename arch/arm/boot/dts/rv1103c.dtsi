// SPDX-License-Identifier: (GPL-2.0+ OR MIT)
/*
 * Copyright (c) 2024 Rockchip Electronics Co., Ltd.
 */

#include "rv1103b.dtsi"

/ {
	compatible = "rockchip,rv1103c";

	aliases {
		/delete-property/ ethernet0;
	};
};

/delete-node/ &gmac;
